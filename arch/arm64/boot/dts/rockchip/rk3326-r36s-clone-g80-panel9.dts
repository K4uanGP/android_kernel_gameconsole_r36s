// SPDX-License-Identifier: (GPL-2.0+ OR MIT)
/*
 * EXPERIMENTAL - not tested on hardware by andr36oid. Keep a copy of the
 * files you replace so you can go back.
 *
 * EE clone, G80 board (G80C-MB V1.1, G80CA-MB V1.2; also R36S-V12
 * 2023-08-18 "Variant 1 Panel 3 A") with Panel 9.
 * Source: dArkOSRE ports by southoz (dArkOSRE-R36, clone/G80* Panel 9).
 */

/dts-v1/;
#include "rk3326-r36s-clone-ee.dtsi"
#include "rk3326-r36s-clone-panel9.dtsi"

/ {
	model = "R36S clone G80, Panel 9 (experimental)";
};
