// SPDX-License-Identifier: (GPL-2.0+ OR MIT)
/*
 * EXPERIMENTAL - not tested on hardware by andr36oid. Keep a copy of the
 * files you replace so you can go back.
 *
 * Soy Sauce Y3506_V03_20241210 batch 2533 (the Panel 5 panel, select and
 * FN swapped).
 * Source: dArkOSRE port by southoz (dArkOSRE-R36, soysauce/Y3506_v03_20241210 2533).
 */

/dts-v1/;
#include "rk3326-r36s-clone-soysauce.dtsi"
#include "rk3326-r36s-clone-panel-soy5.dtsi"

/ {
	model = "R36S clone Soy Sauce 253x, Panel 5 (experimental)";
};

/* this batch swaps select and FN */
&joypad {
	sw13 { gpios = <&gpio3 RK_PA5 GPIO_ACTIVE_LOW>; };	/* FN */
	sw19 { gpios = <&gpio3 RK_PA4 GPIO_ACTIVE_LOW>; };	/* select */
};
