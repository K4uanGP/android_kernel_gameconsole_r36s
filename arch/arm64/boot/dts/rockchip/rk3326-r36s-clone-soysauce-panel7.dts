// SPDX-License-Identifier: (GPL-2.0+ OR MIT)
/*
 * EXPERIMENTAL - not tested on hardware by andr36oid. Keep a copy of the
 * files you replace so you can go back.
 *
 * Soy Sauce Y3506_V03_20241104 and Y3506_V03_20241210 batch 2507 (Panel 7).
 * Source: dArkOSRE ports by southoz (dArkOSRE-R36, soysauce/).
 */

/dts-v1/;
#include "rk3326-r36s-clone-soysauce.dtsi"
#include "rk3326-r36s-clone-panel-soy7.dtsi"

/ {
	model = "R36S clone Soy Sauce, Panel 7 (experimental)";
};
