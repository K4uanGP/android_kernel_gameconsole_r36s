// SPDX-License-Identifier: (GPL-2.0+ OR MIT)
/*
 * EXPERIMENTAL - not tested on hardware by andr36oid. Keep a copy of the
 * files you replace so you can go back.
 *
 * EE clone, K36/HG36 board with Panel 1 (same panel as the G80 "Panel 8").
 * Seen as K36, HG36 (HG3506), ANS11, L35, R36 Pro, MyMini, EmuELEC "R36S"
 * clones with Panel 1, R36S-V20 2025-05-18 batches 2548/2549.
 * Sources: K4uanGP's HG36/K36 andr36oid ports (Andr36oid-dtb-for-Clones),
 * LED pins from immo2n's R36S-K36-DTB-PATCH, stock DTBs.
 */

/dts-v1/;
#include "rk3326-r36s-clone-ee-k36.dtsi"
#include "rk3326-r36s-clone-panel8.dtsi"

/ {
	model = "R36S clone K36/HG36, Panel 1 (experimental)";
};
