## drivers/net/wireless/aic8800/Kconfig
```kconfig
config AIC_WLAN_SUPPORT
	bool "AIC8800 USB WiFi support"
	depends on USB
	default n
	help
	  Support for AICSemi AIC8800 (D80/DC/DW/D80X2) based USB WiFi 6
	  dongles. Firmware is read from /vendor/firmware/<chip>/.

if AIC_WLAN_SUPPORT
source "drivers/net/wireless/aic8800/aic8800_fdrv/Kconfig"
source "drivers/net/wireless/aic8800/aic_load_fw/Kconfig"
endif
```

## drivers/net/wireless/rockchip_wlan/rk915/Kconfig
```kconfig
#
# Rockchip RK915 Wireless drivers
#

config RK915
	tristate "Rockchip RK915 Wireless drivers"
	depends on MMC && RFKILL_RK
	select WIRELESS_EXT
	select WEXT_PRIV
	select CFG80211
	select MAC80211

	help
		Rockchip RK915 Wireless drivers
```

## drivers/net/wireless/rtl8188gu/Kconfig
```kconfig
config RTL8188GU
	tristate "Realtek 8188GU/8710BU USB WiFi"
	depends on USB
	---help---
	  Realtek vendor driver for RTL8188GU (RTL8710BU) USB WiFi dongles.
```

## drivers/net/wireless/rtl8192eu/Kconfig
```kconfig
config RTL8192EU
	tristate "Realtek 8192EU USB WiFi"
	depends on USB
	help
	  Realtek vendor driver for RTL8192EU USB WiFi dongles.
```

## drivers/net/wireless/rtl8192fu/Kconfig
```kconfig
config RTL8192FU
	tristate "Realtek 8192FU USB WiFi"
	depends on USB
	help
	  Realtek vendor driver for RTL8192FU USB WiFi dongles.
```

## drivers/net/wireless/rtl8852bu/Kconfig
```kconfig
config RTL8852BU
	tristate "Realtek 8852BU/8832BU USB WiFi 6"
	depends on USB
	help
	  Realtek vendor driver for RTL8852BU/RTL8832BU based WiFi 6 USB
	  dongles.
```
